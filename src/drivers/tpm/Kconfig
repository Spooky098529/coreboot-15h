## src/drivers/tpm/Kconfig
```kconfig
config TPM_INIT
	bool
	default y if TPM1 || TPM2
	depends on !VBOOT && !TPM_MEASURED_BOOT_INIT_BOOTBLOCK
	help
	  This driver automatically initializes the TPM if vboot is not used.
	  The TPM driver init is done during the ramstage chip init phase.
```

## src/mainboard/asus/crosshair-v-formula-z/Kconfig
```kconfig
if BOARD_ASUS_CROSSHAIR_V_FORMULA_Z

config BOARD_SPECIFIC_OPTIONS
	def_bool y
	select AGESA_LEGACY
	select CPU_AMD_AGESA_FAMILY15
	select CPU_AMD_SOCKET_AM3R2
	select NORTHBRIDGE_AMD_AGESA_FAMILY15
	select NORTHBRIDGE_AMD_CIMX_RD890
	select SOUTHBRIDGE_AMD_CIMX_SB800
	select SB_SUPERIO_HWM
	select HAVE_PIRQ_TABLE
	select HAVE_ACPI_TABLES
	select HAVE_OPTION_TABLE
	select BOARD_ROMSIZE_KB_8192
	select SUPERIO_ITE_IT8721F
	select DRIVERS_PC80_PC_KBD
	select MAINBOARD_HAS_LPC_TPM

config MAINBOARD_DIR
	string
	default "asus/crosshair-v-formula-z"

config MAINBOARD_PART_NUMBER
	string
	default "Crosshair V Formula-Z"

config MAX_CPUS
	int
	default 8

config IRQ_SLOT_COUNT
	int
	default 21

config HPET_ADDRESS
	hex
	default 0xFED00000

config HW_MEM_HOLE_SIZEK
	hex
	default 0x200000

comment "VRM / PMBus configuration (ENE KB3722Q bridge on O2_SMB1)"

config BOARD_VRM_REPORT
	bool "Log VCore voltage at POST time"
	default y
	help
	  Read ASP1000C READ_VOUT (PMBus 0x8B) after AGESA memory init and
	  print the measured CPU VCore in millivolts to the coreboot console.
	  Useful for confirming that the voltage rail is within spec.

config BOARD_VRM_ASP0911
	bool "Enable ASP0911 power meter driver"
	default y
	help
	  Build and probe the ASP0911 (UPI Semiconductor, component PU2000)
	  CPU power meter via the KB3722Q PMBus bridge.  Logs VIN, IOUT, and
	  POUT at BIOS_INFO level during ramstage.  The driver will probe
	  candidate addresses on O2_SMB1 to locate the device; set
	  ASP0911_SLAVE_ADDR to skip the probe if the address is known.

config ASP0911_SLAVE_ADDR
	hex "ASP0911 PMBus 8-bit write address (0 = probe at runtime)"
	depends on BOARD_VRM_ASP0911
	default 0x0
	help
	  Set to the confirmed 8-bit write address of the ASP0911 power meter
	  on O2_SMB1 (7-bit addr << 1).  Leave at 0 to auto-probe from the
	  candidate list: 0x44 (7-bit 0x22), 0x80 (0x40), 0x88 (0x44),
	  0x90 (0x48).  The confirmed address can be read from the coreboot
	  console after the first successful probe.

config BOARD_VRM_DIAG
	bool "Dump full PMBus register set for all known VRM devices at boot"
	default n
	help
	  At ramstage mainboard init, read and log every standard and
	  vendor-specific PMBus register from the ASP1000C CPU VCore controller
	  and the ASP0911 CPU power meter (and probe for the ASP1103 DRAM VRM).
	  Output includes PMBUS_REVISION, CAPABILITY, VOUT_MODE, all VOUT config
	  registers decoded both ways (packed-linear and VOUT_MODE-scaled), all
	  STATUS_* registers decoded to named fault bits, all READ_* telemetry
	  registers, MFR_ID/MODEL/REVISION block reads, and a scan of unknown
	  vendor-specific registers.  Enable this to characterise the VRM devices
	  and confirm register encodings; leave disabled in normal builds.

endif # BOARD_ASUS_CROSSHAIR_V_FORMULA_Z
```

## src/mainboard/asus/sabertooth-990fx-r2/Kconfig
```kconfig
if BOARD_ASUS_SABERTOOTH_990FX_R2

config BOARD_SPECIFIC_OPTIONS
	def_bool y
	select AGESA_LEGACY
	select CPU_AMD_AGESA_FAMILY15
	select CPU_AMD_SOCKET_AM3R2
	select NORTHBRIDGE_AMD_AGESA_FAMILY15
	select NORTHBRIDGE_AMD_CIMX_RD890
	select SOUTHBRIDGE_AMD_CIMX_SB800
	select HAVE_PIRQ_TABLE
	select HAVE_MP_TABLE
	select HAVE_ACPI_TABLES
	select HAVE_OPTION_TABLE
	select BOARD_ROMSIZE_KB_8192
	select SUPERIO_ITE_IT8721F
	select DRIVERS_PC80_PC_KBD
	select MAINBOARD_HAS_LPC_TPM
	select LPC_TPM
	select MAINBOARD_HAS_TPM2

config MAINBOARD_DIR
	string
	default "asus/sabertooth-990fx-r2"

config MAINBOARD_PART_NUMBER
	string
	default "Sabertooth 990FX R2.0"

config MAX_CPUS
	int
	default 8

config IRQ_SLOT_COUNT
	int
	default 21

config HPET_ADDRESS
	hex
	default 0xFED00000

config HW_MEM_HOLE_SIZEK
	hex
	default 0x200000

endif # BOARD_ASUS_SABERTOOTH_990FX_R2
```

## src/southbridge/amd/cimx/sb800/Kconfig
```kconfig
##
## This file is part of the coreboot project.
##
## Copyright (C) 2011 Advanced Micro Devices, Inc.
##
## This program is free software; you can redistribute it and/or modify
## it under the terms of the GNU General Public License as published by
## the Free Software Foundation; version 2 of the License.
##
## This program is distributed in the hope that it will be useful,
## but WITHOUT ANY WARRANTY; without even the implied warranty of
## MERCHANTABILITY or FITNESS FOR A PARTICULAR PURPOSE.  See the
## GNU General Public License for more details.
##

config SOUTHBRIDGE_AMD_CIMX_SB800
	bool
	default n
	select IOAPIC
	select HAVE_USBDEBUG_OPTIONS
	select AMD_SB_CIMX
	select HAVE_CF9_RESET
	select HAVE_CF9_RESET_PREPARE
	# The SB800 azalia_ops.init points at azalia_audio_init() so
	# the codec verb table from the mainboard's hda_verb.c gets
	# written to the codec.  That function lives in
	# src/device/azalia_device.c, which only builds when
	# AZALIA_PLUGIN_SUPPORT is selected.
	select AZALIA_PLUGIN_SUPPORT

if SOUTHBRIDGE_AMD_CIMX_SB800
config BOOTBLOCK_SOUTHBRIDGE_INIT
	string
	default "southbridge/amd/cimx/sb800/bootblock.c"

config ENABLE_IDE_COMBINED_MODE
	bool "Enable SATA IDE combined mode"
	default n
	help
	  If Combined Mode is enabled. IDE controller is exposed and
	  SATA controller has control over Port0 through Port3,
	  IDE controller has control over Port4 and Port5.

	  If Combined Mode is disabled, IDE controller is hidden and
	  SATA controller has full control of all 6 Ports when operating in non-IDE mode.

config IDE_COMBINED_MODE
	hex
	default 0x0 if ENABLE_IDE_COMBINED_MODE
	default 0x1 if !ENABLE_IDE_COMBINED_MODE

choice
	prompt "SATA Controller Mode"
	default SB800_SATA_AHCI

config SB800_SATA_NATIVE_IDE
	bool "Native IDE"

config SB800_SATA_RAID
	bool "RAID"

config SB800_SATA_AHCI
	bool "AHCI"

config SB800_SATA_LEGACY_IDE
	bool "Legacy IDE"

config SB800_SATA_IDE_TO_AHCI
	bool "IDE -> AHCI"

config SB800_SATA_AHCI_AMD
	bool "AHCI, AMD driver"

config SB800_SATA_IDE_TO_AHCI_AMD
	bool "IDE -> AHCI, AMD driver"

endchoice

config SB800_SATA_MODE
	hex
	default 0x00 if SB800_SATA_NATIVE_IDE
	default 0x01 if SB800_SATA_RAID
	default 0x02 if SB800_SATA_AHCI
	default 0x03 if SB800_SATA_LEGACY_IDE
	default 0x04 if SB800_SATA_IDE_TO_AHCI
	default 0x05 if SB800_SATA_AHCI_AMD
	default 0x06 if SB800_SATA_IDE_TO_AHCI_AMD

config SB800_SATA_CLK_AUTO_OFF
	bool "SATA reference clock auto-off when idle (power saving)"
	default n
	help
	  Sets sb_config->SataClkAutoOff so SATA reference clocks are gated
	  when the link is idle.  Saves a small amount of idle power but
	  has been observed to cause boot hangs on SB950 when a SATA device
	  is connected at power-on; PHY bring-up races against clock
	  re-gating.  Disable unless experimenting with power savings on a
	  system that boots reliably without SATA devices at power-on.

config SB800_SATA_PHY_PLL_SHUTDOWN
	bool "SATA PHY PLL shutdown when idle (power saving)"
	default n
	help
	  Power down the SATA PHY PLL when no devices are connected.
	  Ported from the SB900 CIMx (RPR section on SATA PHY power
	  management; same silicon as SB800/SB950).  Like CLK_AUTO_OFF
	  this can cause boot hangs on SB950 when devices are attached at
	  power-on.  Disabled by default.

	  This sets SATA PCI Config REG87[6] (or REG87[6,7] on A11 silicon),
	  and on A12+ also sets REG48[11], REG4C[31:26]=0x3F, REG84[31]=0.

config SB800_USB_PHY_POWER_DOWN
	bool "USB PHY power-down on disconnected ports (power saving)"
	default n
	help
	  Sets sb_config->UsbPhyPowerDown so the USB PHY is powered down
	  on ports with no connected device.  Saves a small amount of
	  power but is incompatible with some keyboards/devices that
	  generate noise on the line during enumeration.  Disabled by
	  default.

config SB_SUPERIO_HWM
	bool
	default n

if SB800_SATA_AHCI
config AHCI_ROM_ID
	string "AHCI device PCI IDs"
	default "1002,4391"

config SB800_AHCI_ROM
	bool "Add a AHCI ROM"

config AHCI_ROM_FILE
	string "AHCI ROM path and filename"
	depends on SB800_AHCI_ROM
	default "site-local/sb800/ahci.bin"
endif

if SB800_SATA_RAID
config RAID_ROM_ID
	string "RAID device PCI IDs"
	default "1002,4393"
	help
	  1002,4392 for SATA NON-RAID5 module, 1002,4393 for SATA RAID5 mode

config RAID_ROM_FILE
	string "RAID ROM path and filename"
	depends on SB800_SATA_RAID
	default "site-local/sb800/raid.bin"

config RAID_MISC_ROM_FILE
	string "RAID Misc ROM path and filename"
	default "site-local/sb800/misc.bin"
	depends on SB800_SATA_RAID

config RAID_MISC_ROM_POSITION
	hex "RAID Misc ROM Position"
	default 0xFFF00000
	depends on SB800_SATA_RAID
	help
	  The RAID ROM requires that the MISC ROM is located between the range
	  0xFFF0_0000 to 0xFFF0_FFFF. Also, it must 1K bytes aligned.
	  The CONFIG_ROM_SIZE must larger than 0x100000.

endif

config SB800_IMC_FWM
	bool "Add IMC firmware"
	default n
	select SPI_FLASH_HAS_VOLATILE_GROUP if SPI_FLASH
	help
	  Add SB800 / Hudson 1 IMC Firmware to support the onboard fan control.

if SB800_IMC_FWM

config SB800_IMC_FWM_FILE
	string "IMC firmware path and filename"
	default "3rdparty/blobs/southbridge/amd/sb800/imc.bin"

choice
	prompt "SB800 Firmware ROM Position"

config SB800_FWM_AT_FFFA0000
	bool "0xFFFA0000"
	help
	  The IMC and GEC ROMs requires a 'signature' located at one of several
	  fixed locations in memory.  The location used shouldn't matter, just
	  select an area that doesn't conflict with anything else.

config SB800_FWM_AT_FFF20000
	bool "0xFFF20000"
	help
	  The IMC and GEC ROMs requires a 'signature' located at one of several
	  fixed locations in memory.  The location used shouldn't matter, just
	  select an area that doesn't conflict with anything else.

config SB800_FWM_AT_FFE20000
	depends on BOARD_ROMSIZE_KB_8192 || BOARD_ROMSIZE_KB_4096 || BOARD_ROMSIZE_KB_2048
	bool "0xFFE20000"
	help
	  The IMC and GEC ROMs requires a 'signature' located at one of several
	  fixed locations in memory.  The location used shouldn't matter, just
	  select an area that doesn't conflict with anything else.

config SB800_FWM_AT_FFC20000
	depends on BOARD_ROMSIZE_KB_8192 || BOARD_ROMSIZE_KB_4096
	bool "0xFFC20000"
	help
	  The IMC and GEC ROMs requires a 'signature' located at one of several
	  fixed locations in memory.  The location used shouldn't matter, just
	  select an area that doesn't conflict with anything else.

config SB800_FWM_AT_FF820000
	depends on BOARD_ROMSIZE_KB_8192
	bool "0xFF820000"
	help
	  The IMC and GEC ROMs requires a 'signature' located at one of several
	  fixed locations in memory.  The location used shouldn't matter, just
	  select an area that doesn't conflict with anything else.

endchoice

config SB800_FWM_POSITION
	hex
	default 0xFFFA0000 if SB800_FWM_AT_FFFA0000
	default 0xFFF20000 if SB800_FWM_AT_FFF20000
	default 0xFFE20000 if SB800_FWM_AT_FFE20000
	default 0xFFC20000 if SB800_FWM_AT_FFC20000
	default 0xFF820000 if SB800_FWM_AT_FF820000

endif  #SB800_IMC_FWM

config EHCI_BAR
	hex
	default 0xfef00000

choice
	prompt "Fan Control"
	default SB800_NO_FAN_CONTROL
	help
	  Select the method of SB800 fan control to be used.  None would be
	  for either fixed maximum speed fans connected to the SB800 or for
	  an external chip controlling the fan speeds.  Manual control sets
	  up the SB800 fan control registers.  IMC fan control uses the SB800
	  IMC to actively control the fan speeds.

config SB800_NO_FAN_CONTROL
	bool "None"
	help
	  No SB800 Fan control - Do not set up the SB800 fan control registers.

config SB800_MANUAL_FAN_CONTROL
	bool "Manual"
	help
	  Configure the SB800 fan control registers in devicetree.cb.

config SB800_IMC_FAN_CONTROL
	bool "IMC Based"
	depends on SB800_IMC_FWM
	help
	  Set up the SB800 to use the IMC based Fan controller.  This requires
	  the IMC ROM from AMD.  Configure the registers in devicetree.cb.

endchoice

endif #SOUTHBRIDGE_AMD_CIMX_SB800
```

## src/superio/winbond/w83527hg/Kconfig
```kconfig
# SPDX-License-Identifier: GPL-2.0-only

config SUPERIO_WINBOND_W83527HG
	bool
	select SUPERIO_WINBOND_COMMON_PRE_RAM
```
